/**
 * @file    dev_oled.c
 * @brief   Triển khai giao tiếp I2C1 và xuất dữ liệu hiển thị cho OLED SSD1306
 */

#include "dev_oled.h"
#include "bsp_pinout.h"

/* Mảng Font 8x8 chứa mã bitmap các ký tự ASCII từ ' ' (32) đến 'Z' (90) */
static const uint8_t Font8x8[][OLED_FONT_WIDTH] = {
    {0x00,0x00,0x00,0x00,0x00,0x00,0x00,0x00}, {0x00,0x00,0x5F,0x00,0x00,0x00,0x00,0x00},
    {0x00,0x07,0x00,0x07,0x00,0x00,0x00,0x00}, {0x14,0x7F,0x14,0x7F,0x14,0x00,0x00,0x00},
    {0x24,0x2A,0x7F,0x2A,0x12,0x00,0x00,0x00}, {0x23,0x13,0x08,0x64,0x62,0x00,0x00,0x00},
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    {0x61,0x51,0x49,0x45,0x43,0x00,0x00,0x00}
};

/* ========================================================================== */
/* CÁC HÀM NỘI BỘ GIAO TIẾP BUS I2C1 (STATIC HELPER FUNCTIONS)              */
/* ========================================================================== */

static void I2C_Start(void) { 
    I2C1->CR1 |= I2C_CR1_START; 
    while (!(I2C1->SR1 & I2C_SR1_SB)); 
}

static void I2C_Write(uint8_t data) { 
    I2C1->DR = data; 
    while (!(I2C1->SR1 & I2C_SR1_TXE)); 
}

static void I2C_Stop(void) { 
    I2C1->CR1 |= I2C_CR1_STOP; 
}

static void OLED_SendCmd(uint8_t cmd) { 
    I2C_Start(); 
    I2C_Write(OLED_I2C_ADDR); 
    (void)I2C1->SR2; 
    I2C_Write(OLED_CTRL_CMD); 
    I2C_Write(cmd); 
    I2C_Stop(); 
}

/* ========================================================================== */
/* CÁC HÀM ĐIỀU KHIỂN OLED CHÍNH (MAIN OLED API)                              */
/* ========================================================================== */

void OLED_Init(void) {
    Delay_ms(100);
    OLED_SendCmd(OLED_CMD_DISPLAY_OFF); 
    OLED_SendCmd(OLED_CMD_MEM_ADDR_MODE); 
    OLED_SendCmd(OLED_CMD_ADDR_MODE_HORIZ);
    OLED_SendCmd(OLED_CMD_CHARGE_PUMP); 
    OLED_SendCmd(OLED_CMD_CHARGE_PUMP_ON); 
    OLED_SendCmd(OLED_CMD_DISPLAY_ON);
    Delay_ms(100);
}

void OLED_Clear(void) {
    OLED_SendCmd(OLED_CMD_SET_PAGE_START); 
    OLED_SendCmd(OLED_CMD_SET_COLUMN_LOW); 
    OLED_SendCmd(OLED_CMD_SET_COLUMN_HIGH);
    
    I2C_Start(); 
    I2C_Write(OLED_I2C_ADDR); 
    (void)I2C1->SR2; 
    I2C_Write(OLED_CTRL_DATA);
    
    for (uint16_t i = 0; i < OLED_TOTAL_PIXEL_BYTES; i++) {
        I2C_Write(0x00);
    }
    I2C_Stop();
}

void OLED_SetCursor(uint8_t page, uint8_t col) {
    OLED_SendCmd(OLED_CMD_SET_PAGE_START + page);
    OLED_SendCmd(col & 0x0F);
    OLED_SendCmd(OLED_CMD_SET_COLUMN_HIGH | ((col >> 4) & 0x0F));
}

void OLED_PutChar(char c) {
    if (c < OLED_ASCII_OFFSET || c > OLED_ASCII_MAX) {
        c = OLED_ASCII_OFFSET;
    }

    uint8_t idx = (uint8_t)(c - OLED_ASCII_OFFSET);
    I2C_Start();
    I2C_Write(OLED_I2C_ADDR);
    (void)I2C1->SR2;
    I2C_Write(OLED_CTRL_DATA);
    for (uint8_t i = 0; i < OLED_FONT_WIDTH; i++) {
        I2C_Write(Font8x8[idx][i]);
    }
    I2C_Stop();
}

void OLED_PrintString(uint8_t page, uint8_t col, const char* str) {
    OLED_SetCursor(page, col);

    /* Gửi trọn một hàng trong một transaction I2C thay vì mở/đóng bus cho
       từng ký tự. Điều này giảm đáng kể thời gian chặn CPU. */
    I2C_Start();
    I2C_Write(OLED_I2C_ADDR);
    (void)I2C1->SR2;
    I2C_Write(OLED_CTRL_DATA);

    while (*str) {
        char c = *str;
        if (c >= 'a' && c <= 'z') {
            c -= 32;
        }
        if (c < OLED_ASCII_OFFSET || c > OLED_ASCII_MAX) {
            c = OLED_ASCII_OFFSET;
        }

        uint8_t idx = (uint8_t)(c - OLED_ASCII_OFFSET);
        for (uint8_t i = 0; i < OLED_FONT_WIDTH; i++) {
            I2C_Write(Font8x8[idx][i]);
        }

        str++;
    }

    I2C_Stop();
}
